// SPDX-License-Identifier: (GPL-2.0+ OR MIT)
// Bearbones bring-up for BLU G73 (G0771, UMS9230 1H10). SoC + PMIC + serial console only.
/dts-v1/;

#include "ums9230.dtsi"
#include "sc2730.dtsi"

/ {
	model = "BLU G73 (G0771) bringup";
	compatible = "blu,g0771", "sprd,ums9230-1h10", "sprd,ums9230";

	aliases {
		serial0 = &uart0;	/* TODO: confirm label in ums9230.dtsi */
		serial1 = &uart1;	/* TODO: confirm label in ums9230.dtsi */
	};

	chosen {
		stdout-path = "serial1:115200n8";
		bootargs = "console=ttyS1,115200n8 earlycon=sprd_serial,0x200b0000 loglevel=8 panic=10 rdinit=/init";
	};
};

&uart1 {
	status = "okay";
};
